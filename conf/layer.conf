## conf/layer.conf
```bitbake
# We have a conf and classes directory, add to BBPATH
BBPATH .= ":${LAYERDIR}"

# We have a recipes-* directories, add to BBFILES
BBFILES += "${LAYERDIR}/recipes-*/*/*.bb \
	${LAYERDIR}/recipes-*/*/*.bbappend"

BBFILE_COLLECTIONS += "tq2440"
BBFILE_PATTERN_tq2440 = "^${LAYERDIR}/"
BBFILE_PRIORITY_tq2440 = "6"
```

## conf/machine/mini2440.conf
```bitbake
#@TYPE: Machine
#@NAME: mini2440

#@DESCRIPTION: Machine configuration for mini2440 systems

#PREFERRED_PROVIDER_virtual/xserver = "xserver-xorg"
#XSERVER = "xserver-xorg \
#           xf86-input-evdev \
#           xf86-input-mouse \
#           xf86-video-omap \
#           xf86-input-keyboard"

# Ship all kernel modules by default
MACHINE_EXTRA_RRECOMMENDS = " kernel-modules"
MACHINE_FEATURES = "apm alsa"

# Allow for MMC booting (required by the NAND-less Beagleboard XM)
#EXTRA_IMAGEDEPENDS += "u-boot"

# Uncomment the following line to enable the hard floating point abi. Note that
# this breaks some binary libraries and 3D (neither of which ship with
# meta-yocto). For maximum compatibility, leave this disabled.
#DEFAULTTUNE ?= "cortexa8hf-neon"
include conf/machine/include/tune-arm920t.inc

IMAGE_FSTYPES += "tar.bz2 jffs2"
EXTRA_IMAGECMD_jffs2 = "-lnp "
#MKUBIFS_ARGS = "-m 2048 -e 131072 -c 2005"
#UBINIZE_ARGS = "-m 2048 -p 128KiB -s 512"
#UBI_VOLNAME = "rootfs"

# 2.6.37 and later kernels use OMAP_SERIAL, ttyO2
# earlier kernels use ttyS2
SERIAL_CONSOLE = "115200 ttyO2"


PREFERRED_PROVIDER_virtual/kernel ?= "linux-yocto"
PREFERRED_VERSION_linux-yocto ?= "3.8%"

KERNEL_IMAGETYPE = "uImage"

UBOOT_MACHINE = "mini2440_config"
UBOOT_ENTRYPOINT = "0x30008000"
UBOOT_LOADADDRESS = "0x30008000"

USE_VT = "1"
SERIAL_CONSOLE = "115200 ttySAC0"
APPEND = "console=ttySAC0,115200"
```
